## Kconfig
```kconfig
menu "Android Emulator Virtual Devices"
config AVD_VIRTUAL_DEVICE
    tristate "Android Emulator Virtual Devices"
    default n
    help
      Android Emulator Virtual Devices
endmenu
```

## Kconfig.ext
```kconfig
# SPDX-License-Identifier: GPL-2.0-only
config  BUILTIN_VD
	bool "Build virtual-device drivers into GKI kernel"
	default n
	help
	  Build virtual-device drivers from common Makefile if enabled. 
```

## Kconfig.goldfish_address_space
```kconfig
# SPDX-License-Identifier: GPL-2.0

config GOLDFISH_ADDRESS_SPACE
	bool "GOLDFISH_ADDRESS_SPACE"
	select GOLDFISH_SELECTED
	help
	  GOLDFISH_ADDRESS_SPACE

config GOLDFISH_SELECTED
	bool
```

## kleaf_test/Kconfig.ext
```kconfig
config KLEAF_TEST_Y
	tristate "KLEAF_TEST_Y"

config KLEAF_TEST_NOT_SET
	tristate "KLEAF_TEST_NOT_SET"

config KLEAF_TEST_M
	tristate "KLEAF_TEST_M"

config KLEAF_TEST_MAIN
	tristate "KLEAF_TEST_MAIN"
```

## kleaf_test/menuconfig_test/Kconfig.ext
```kconfig
menu "Kleaf Testing"

config KLEAF_TEST
	tristate "Kleaf test"
	default n
	help
	  A test config.

endmenu
```
